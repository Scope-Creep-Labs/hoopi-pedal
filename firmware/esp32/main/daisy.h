#ifndef E7AD30DD_48D3_4FA7_BC4A_32F2002FE249
#define E7AD30DD_48D3_4FA7_BC4A_32F2002FE249
#include "driver/i2s_std.h"
#include "driver/gpio.h"
#include "esp_check.h"

static const char *TAG = "HOOPI";

#define I2S_24BIT_STD_CLK_DEFAULT_CONFIG(rate) { \
    .sample_rate_hz = rate, \
    .clk_src = I2S_CLK_SRC_DEFAULT, \
    .mclk_multiple = I2S_MCLK_MULTIPLE_1152, \
}


#define EXAMPLE_STD_BCLK_IO1        GPIO_NUM_4      // I2S bit clock io number
#define EXAMPLE_STD_WS_IO1          GPIO_NUM_3      // I2S word select io number
#define EXAMPLE_STD_DIN_IO1         GPIO_NUM_2     // I2S data in io number
#define EXAMPLE_STD_DOUT_IO1        GPIO_NUM_1     // I2S data out io number

i2s_chan_handle_t                tx_chan;        // I2S tx channel handler (non-static for playback access)
static i2s_chan_handle_t                rx_chan;        // I2S rx channel handler

#define BUFFER_SIZE               1*300 * 48 * 2 * 4  // 115,200 bytes (300ms of 48kHz stereo 32-bit)

const size_t SAMPLE_RATE = 48000;

uint8_t* raw_buf1;
uint8_t* raw_buf2;

volatile bool buf1_full = false;
volatile bool buf2_full = false;

int error_count = 0;

static void i2s_read_task(void *args)
{
    // int32_t t[2];
    // t[0] = f2s24(0.96f);
    // t[1] = f2s24(0.24f);
    
    // uint8_t *t_p = (uint8_t *)t;

    // assert(r_buf); // Check if r_buf allocation success
    size_t r_bytes = 0;

    /* Enable the RX channel */
    ESP_ERROR_CHECK(i2s_channel_enable(rx_chan));
    // int32_t *i_buf = (int32_t *) raw_buf1;

    for (size_t i = 0; i < BUFFER_SIZE; i++) {
        raw_buf1[i] = raw_buf2[i] = 0;
    }


    /* ATTENTION: The print and delay in the read task only for monitoring the data by human,
     * Normally there shouldn't be any delays to ensure a short polling time,
     * Otherwise the dma buffer will overflow and lead to the data lost */
    while (1) {
        // printf("Producer: %d %d\n", buf1_full, buf2_full);
        /* Read i2s data */
        if (!buf1_full) {
            if (i2s_channel_read(rx_chan, raw_buf1, BUFFER_SIZE, &r_bytes, 100) == ESP_OK)
            {
                // printf("Read Task: i2s read %d bytes, buffer capacity: %d \n-----------------------------------\n", r_bytes, BUFFER_SIZE);

                // printf("[0] %ld %x %x %x %x %x %x %x %x %ld %f %d [1] %d %x %x %x %x %x %x %x %x %ld %d\n\n",
                //    f2s24(0.96f), t_p[0], t_p[1], t_p[2], t_p[3], r_buf[0], r_buf[1], r_buf[2], r_buf[3], i_buf[0], f_buf[0], f2s16(f_buf[0]), f2s16(0.96f), t_p[4], t_p[5], t_p[6], t_p[7], r_buf[4], r_buf[5], r_buf[6], r_buf[7], i_buf[1], f2s16(f_buf[1]));

                // printf("[0] %x %x %x %x = %d [1] %x %x %x %x = 24bit: %ld, 16shifted: %ld float: %f 16bit: %d  \n\n",
                //    raw_buf1[0], raw_buf1[1], raw_buf1[2], raw_buf1[3], f2s16(s242f(i_buf[0] >> 8)), raw_buf1[4], raw_buf1[5], raw_buf1[6], raw_buf1[7], i_buf[1]>>8, i_buf[1] >> 16, s242f(i_buf[0] >> 8), f2s16(s242f(i_buf[1] >> 8)));

                buf1_full = true;
            }
            // else
            // {
            //     printf("Read Task: i2s read into buf1 failed\n");
            // }
        }
        else if (!buf2_full) {

            if (i2s_channel_read(rx_chan, raw_buf2, BUFFER_SIZE, &r_bytes, 100) == ESP_OK)
            {
                buf2_full = true;
            }
            // else
            // {
            //     printf("Read Task: i2s read into buf2 failed\n");
            // }
        }
        else {

            ESP_LOGE(TAG, "Both buffers full. Waiting 1 second ....");
            vTaskDelay(pdMS_TO_TICKS(1000));
            error_count++;
        }
    }
    vTaskDelete(NULL);
}

static void i2s_init_std_duplex(void)
{
    /* Setp 1: Determine the I2S channel configuration and allocate both channels
     * The default configuration can be generated by the helper macro,
     * it only requires the I2S controller id and I2S role */
    i2s_chan_config_t chan_cfg = I2S_CHANNEL_DEFAULT_CONFIG(I2S_NUM_AUTO, I2S_ROLE_SLAVE);
    ESP_ERROR_CHECK(i2s_new_channel(&chan_cfg, &tx_chan, &rx_chan));

    /* Step 2: Setting the configurations of standard mode, and initialize rx & tx channels
     * The slot configuration and clock configuration can be generated by the macros
     * These two helper macros is defined in 'i2s_std.h' which can only be used in STD mode.
     * They can help to specify the slot and clock configurations for initialization or re-configuring */

    /* Custom MSB slot config with ws_pol=true to match Daisy Seed's SAI_I2S_MSBJUSTIFIED format.
     * The Daisy uses MSB Justified (Left Justified) where WS HIGH = Left channel.
     * ESP-IDF's default MSB config uses ws_pol=false (WS LOW = Left), causing a channel swap.
     * Setting ws_pol=true aligns the channel interpretation between both devices. */
    i2s_std_slot_config_t slot_cfg = {
        .data_bit_width = I2S_DATA_BIT_WIDTH_32BIT,
        .slot_bit_width = I2S_SLOT_BIT_WIDTH_AUTO,
        .slot_mode = I2S_SLOT_MODE_STEREO,
        .slot_mask = I2S_STD_SLOT_BOTH,
        .ws_width = I2S_DATA_BIT_WIDTH_32BIT,
        .ws_pol = true,  // WS HIGH = Left channel (matches Daisy's MSB Justified)
        .bit_shift = false,
        .left_align = true,
        .big_endian = false,
        .bit_order_lsb = false,
    };

    i2s_std_config_t std_cfg = {
        .clk_cfg  = I2S_24BIT_STD_CLK_DEFAULT_CONFIG(SAMPLE_RATE),
        .slot_cfg = slot_cfg,
        .gpio_cfg = {
            .mclk = I2S_GPIO_UNUSED,    
            .bclk = EXAMPLE_STD_BCLK_IO1,
            .ws   = EXAMPLE_STD_WS_IO1,
            .dout = EXAMPLE_STD_DOUT_IO1,
            .din  = EXAMPLE_STD_DIN_IO1, // In duplex mode, bind output and input to a same gpio can loopback internally
            .invert_flags = {
                .mclk_inv = false,
                .bclk_inv = false,
                .ws_inv   = false,
            },
        },
    };
    /* Initialize the channels */
    ESP_ERROR_CHECK(i2s_channel_init_std_mode(tx_chan, &std_cfg));
    ESP_ERROR_CHECK(i2s_channel_init_std_mode(rx_chan, &std_cfg));

    raw_buf1 = (uint8_t *)heap_caps_malloc(BUFFER_SIZE, MALLOC_CAP_SPIRAM);
    raw_buf2 = (uint8_t *)heap_caps_malloc(BUFFER_SIZE, MALLOC_CAP_SPIRAM);
}

#endif /* E7AD30DD_48D3_4FA7_BC4A_32F2002FE249 */
